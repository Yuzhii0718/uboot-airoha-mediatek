## failsafe/Kconfig
```kconfig
#
# WebUI Failsafe
#

comment "WebUI failsafe"

menuconfig WEBUI_FAILSAFE
	bool "Enable Failsafe Web UI"
	select MTK_TCP
	select MTK_HTTPD
	select MTK_DHCPD
	select MD5
	default n
	help
	  Enable the failsafe Web UI, a minimal Web server (httpd + dhcpd +
	  dnsd) that allows a device without a functional system image to be
	  recovered over the network: firmware / bootloader (the 512 KiB
	  u-boot image or the FIP) / preloader (bl2) / initramfs can be
	  uploaded and written to the corresponding storage.

	  The Web UI resources (fsdata) and the individual pages are selected
	  by the options below: each page is only embedded when the matching
	  option is enabled, and the UI dynamically shows the available
	  entries.

if WEBUI_FAILSAFE

config WEB_FAILSAFE_AFTER_BOOT_FAILURE
	bool "Automatically start failsafe after booting failure"
	default y
	help
	  This option allow user to upgrade a workable firmware image if no
	  firmware image available for boot.

	  It also enables the "bootfailsafe" command, which the boot scripts
	  run before their TFTP recovery fallback so that a failed boot has
	  priority over the (endless) TFTP recovery loop.

config WEBUI_FAILSAFE_COLOR
	bool "VT100 colored console output"
	depends on WEBUI_FAILSAFE
	default y
	help
	  Print failsafe status / error / warning messages to the serial
	  console using VT100 / ANSI SGR escape codes so errors, cautions
	  and prompts are visually distinguishable from normal text.

	  Disable this when the console is not a VT100 terminal (the escape
	  codes would otherwise show up as garbage).  The Web console keeps
	  rendering them (its JSON layer round-trips the CSI sequences).

config WEBUI_FAILSAFE_LED
	bool "LED status indication"
	depends on LED
	default y
	help
	  Drive the board LEDs from the failsafe workflow: waiting for the
	  button, the idle web UI, an upgrade in progress and its result.

	  Labels and effects come from the environment only, so no board
	  code or device tree change is required:

	    failsafe_led_idle     waiting for a key press (btnchk)
	    failsafe_led_ready    web failsafe UI running and idle
	    failsafe_led_upgrade  an image is being flashed
	    failsafe_led_success  upgrade finished successfully
	    failsafe_led_fail     upgrade failed

	  An effect is a list of frames separated by ';', each frame is a
	  comma-separated list of '<led-label> [on|off|toggle|blink] [ms]'.
	  Frames rotate every 'failsafe_led_period' milliseconds (default
	  250) and LEDs that are not listed in the current frame are
	  switched off, so 'a on;b on;c on' rotates over three LEDs.  An
	  unset variable means no LED activity for that phase, and labels
	  that do not exist on the board are ignored - one environment
	  works on several boards.

	  This option is automatically unavailable on boards without LED
	  support (it depends on CONFIG_LED); when disabled, the LED
	  handling is compiled out completely and every caller turns into
	  an empty stub.

choice
	prompt "Failsafe layout"
	default WEBUI_FAILSAFE_LAYOUT_UBOOT
	help
	  Select the bootloader layout the failsafe covers, which also
	  decides its feature set and the embedded web resources (fsdata).

config WEBUI_FAILSAFE_LAYOUT_UBOOT
	bool "U-Boot layout (u-boot MTD partition)"
	help
	  512 KiB boot image layout:
	    - System firmware upgrade  (one FIT image: the "fit" UBI volume,
	                                or a "fit" / "firmware" /
	                                "production" partition on MMC)
	    - U-Boot upgrade           (u-boot MTD partition)
	    - Initramfs RAM boot

if ARM

config WEBUI_FAILSAFE_LAYOUT_FIP
	bool "FIP layout (bl2 + fip partitions)"
	help
	  Split FIP layout:
	    - System firmware upgrade  (one FIT image: the "fit" UBI volume,
	                                or a "fit" / "firmware" /
	                                "production" partition on MMC)
	    - Preloader upgrade        (bl2: MTD partition, or the layout the
	                                SoC bootrom expects on eMMC / SD)
	    - FIP upgrade              (UBI volume "fip", or the "fip" MMC
	                                partition the ATF loads)
	    - Initramfs RAM boot

config WEBUI_FAILSAFE_LAYOUT_CHAINLOADER
	bool "Chainloader layout (bl2 + chainloader partitions)"
	help
	  Chainloader failsafe:
	    - System firmware upgrade  (one FIT image, as above)
	    - Preloader upgrade        (bl2: MTD partition, or the SoC
	                                specific eMMC / SD location)
	    - Chainloader upgrade      (chainloader MTD partition)
	    - Initramfs RAM boot

endif # ARM

endchoice

config WEBUI_FAILSAFE_FIP_SIZE
	hex "FIP storage size in bytes" if WEBUI_FAILSAFE_LAYOUT_FIP
	default 0x200000 if ARCH_MEDIATEK
	default 0x100000
	help
	  Size of the storage that holds the FIP (BL31 + U-Boot) on a device
	  built with the FIP layout: the Web UI creates the "fip" UBI volume
	  at this size, rejects uploaded images that do not fit and bounds
	  the read used to report the flashed BL31 banner.

	  It has to match the layout the boot chain expects (a smaller value
	  truncates the FIP, a larger one only wastes flash):
	    - Airoha:   1 MiB (0x100000), the default here,
	    - MediaTek: 2 MiB (0x200000), the default for MediaTek.

	  On an MMC device the "fip" is a partition of the partition table
	  instead, whose size decides what fits; this value then only bounds
	  the BL31 banner read.

	  Only the FIP layout offers the option: the other layouts have no
	  "fip" target, but the shared storage code still sizes its read
	  scratch with the value, so it always gets one (1 MiB unless the
	  SoC default above applies).

if MMC && PARTITIONS

config WEBUI_FAILSAFE_GPT
	bool "Enable MMC partition table (GPT) update"
	default y
	help
	  Add the "gpt" page: the partition table of the MMC device can be
	  replaced from the Web UI.

	  The uploaded image is the primary table area of a GPT disk (the
	  protective MBR, the GPT header and the partition entry array, 34
	  sectors = 17408 bytes).  Both are verified before they are
	  written, the header is adjusted to the real device size and the
	  backup table is generated at the end of the device, so a table
	  dump taken from another unit of the same size class can be
	  installed.

	  WARNING: a wrong partition table makes the device unbootable.

endif # MMC && PARTITIONS

choice
	prompt "Failsafe Web UI style"
	default WEBUI_FAILSAFE_UI_BOOTSTRAP
	help
	  Select which Web UI resources to embed into the failsafe firmware
	  image.

config WEBUI_FAILSAFE_UI_BOOTSTRAP
	bool "Bootstrap UI (fsdata-bootstrap)"

config WEBUI_FAILSAFE_UI_BRUTALISM
	bool "Brutalism UI (fsdata-brutalism)"
	depends on WEBUI_FAILSAFE_LAYOUT_UBOOT

endchoice

choice
	prompt "Embedded Web UI asset compression"
	default WEBUI_FAILSAFE_COMPRESS_GZIP
	help
	  How the embedded HTML / CSS / JS / SVG assets are stored and
	  served.

	  NOTE: the failsafe httpd does NOT implement Accept-Encoding
	  negotiation - it always advertises the encoding selected here.
	  Brotli was tried but had to be dropped: browsers never advertise
	  "br" over the plain-HTTP connection the failsafe UI is served on,
	  so brotli payloads always failed to decode on the client.

config WEBUI_FAILSAFE_COMPRESS_GZIP
	bool "gzip -9 (default, universally supported)"
	help
	  Historical behaviour: assets are gzip -9 compressed and served
	  with "Content-Encoding: gzip".  Every HTTP client understands
	  this.

config WEBUI_FAILSAFE_COMPRESS_NONE
	bool "None - store the minified assets as-is"
	help
	  Store the minified (but not compressed) assets and serve them
	  with no Content-Encoding at all, so no client-side decoding is
	  involved.

	  This is usually the SMALLEST option in the final image: the
	  finished u-boot.bin is LZMA compressed as a whole and LZMA
	  squeezes plain text far better than it can squeeze an already
	  compressed gzip stream (about 49 KiB vs 64 KiB for the
	  current asset set, i.e. roughly 15 KiB saved versus gzip).

	  The trade-off is runtime RAM: the assets occupy about 155 KiB
	  more of the decompressed U-Boot image, and a full page load
	  transfers about 200 KiB instead of 65 KiB (irrelevant on a
	  LAN).

endchoice

config WEBUI_FAILSAFE_BUILD_VARIANT
	string "Failsafe build variant tag"
	default ""
	help
	  Optional build variant string shown in the failsafe sysinfo page,
	  e.g. "wifi7" or a customer specific tag.

config WEBUI_FAILSAFE_I18N
	bool "Enable I18N dictionary for Web UI"
	default y
	help
	  Embed the i18n.js dictionary so the Web UI can be localized.

if WEBUI_FAILSAFE_I18N

comment "WebUI failsafe Advanced"

config WEBUI_FAILSAFE_I18N_EN
	bool "English"
	default y
	help
	  English is the fallback language of the Web UI and should stay
	  enabled.  Disabling it only removes it from the language
	  switcher; the UI then falls back to another embedded language.

config WEBUI_FAILSAFE_I18N_ZH_CN
	bool "Simplified Chinese"
	default n
	help
	  Embed the zh-cn dictionary (about 5 KiB of compressed data).

config WEBUI_FAILSAFE_I18N_RU
	bool "Russian"
	default n
	help
	  Embed the ru dictionary (about 5 KiB of compressed data).

config WEBUI_FAILSAFE_I18N_TRIM
	bool "Drop the strings of pages that are not built"
	default y
	help
	  Remove the dictionary entries belonging to the pages this firmware
	  does not contain - a page counts as built when its own option
	  (CONFIG_WEBUI_FAILSAFE_UBI, ..._FLASH, CONFIG_WEBUI_FAILSAFE_GPT,
	  the layout options, ...) is enabled.

	  The bootstrap UI ships one dictionary for every page it can show,
	  and roughly a third of it belongs to the pages a given build leaves
	  out, so this is where most of the i18n asset can be saved.

	  A key is kept whenever an embedded asset still mentions it, which
	  covers the shared code (main.js talks about the GPT upload even
	  without the GPT page) and keys that are assembled at run time (the
	  document title, built from the page id).  The build log reports the
	  namespaces that were dropped; turn this off if a translation ever
	  goes missing.

endif # WEBUI_FAILSAFE_I18N

config WEBUI_FAILSAFE_ADVANCED
	bool "Enable advanced features"
	default n
	help
	  Advanced failsafe features: Web console, U-Boot environment
	  management, UBI volume management, flash management, RF-EEPROM /
	  single-image upgrade pages.

if WEBUI_FAILSAFE_ADVANCED

config WEBUI_FAILSAFE_CONSOLE
	bool "Enable Web console"
	select CONSOLE_RECORD
	default y
	help
	  Enable the Web console page. Requires a UART console driver.

config WEBUI_FAILSAFE_ENV
	bool "Enable U-Boot environment management"
	default y
	help
	  Enable the U-Boot environment page: read / write / reset
	  environment variables from the Web UI.

config WEBUI_FAILSAFE_UBI
	bool "Enable UBI volume management"
	depends on MTD && !ENV_IS_IN_MMC && CMD_UBI
	default y
	help
	  Enable the UBI volume management page: list / attach / detach /
	  remove / resize UBI volumes. Useful on SPI-NAND / SPI-NOR boards
	  where the system image lives in a UBI volume.

config WEBUI_FAILSAFE_SIMG
	bool "Enable SIMG (ROM dump) restore"
	default n
	depends on MTD
	help
	  Enable the SIMG page: upload a single raw image (a full ROM dump
	  of the flash chip) and write it to the whole flash device.

	  The image is streamed to the device in erase-block aligned
	  chunks, so a full dump can be restored without staging it in
	  RAM.  There is no read / erase / offset editing: the only
	  operation is "upload a SIMG and write it".

	  WARNING: writing a wrong image overwrites the whole flash,
	  including bootloaders and calibration data.

config WEBUI_FAILSAFE_FLASH
	bool "Enable flash management (backup / restore / edit / erase)"
	default n
	help
	  Enable the flash management page: identify the flash chip
	  (model + partitions), download a backup of a partition or of an
	  arbitrary byte range, read/edit raw bytes in a hex editor,
	  restore a backup file and erase storage ranges.

	  This is the merged successor of the former "backup download" and
	  "flash editor" pages: they now share one page and one module
	  because both operate on the same raw storage targets.

	  WARNING: writing or erasing raw flash can brick the device.

config WEBUI_FAILSAFE_NAND_RAW
	bool "Enable NAND raw/OOB backup and flash"
	default n
	depends on MTD && WEBUI_FAILSAFE_FLASH
	help
	  Extend the flash management page with NAND raw mode: pages are
	  read / written including their OOB (spare area) data through
	  MTD_OPS_RAW, which preserves the ECC layout and makes a NAND dump
	  byte-exact.

	  The mode only exists on NAND devices, so it is compiled out
	  completely when disabled: the whole flash module then works on
	  plain data only (MTD / MMC), and no NAND raw code is linked in.

	  Raw mode needs significantly more memory (page size + OOB size
	  per page) and the dump length is only known to the flash module,
	  so a 128 MiB flash produces a dump larger than the chip size.

config WEBUI_FAILSAFE_FLASH_LAYOUT
	bool "Enable flash layouts from the device tree"
	default n
	depends on WEBUI_FAILSAFE_FLASH
	help
	  Add the flash layouts the board describes in its device tree
	  (a node with compatible = "failsafe-layout") to the flash
	  management page: the editor can then work *in* a layout the
	  device does not currently run - the one of the stock firmware or
	  the one a replacement boot chain installs - instead of only in
	  the partition table the device has now.

	  A layout is a list of named raw flash ranges (<offset size>, a
	  size of 0 meaning "to the end of the device").  Reading, writing,
	  erasing and backing up stay inside the range of the partition
	  that was picked, so the rest of the flash is never touched; a
	  backup taken in a layout is written back into the same layout.

	  The layouts apply to the master MTD chip when the board has one
	  and to the MMC user area otherwise.  Boards without such a node
	  simply have no layout to choose from, and when this option is off
	  no layout code is linked in at all (the page hides the picker).

config WEBUI_FAILSAFE_RPMB
	bool "Read the eMMC RPMB partition from the flash page"
	default y
	depends on WEBUI_FAILSAFE_FLASH && MMC
	select SUPPORT_EMMC_RPMB
	help
	  Offer the RPMB (replay protected memory block) of an eMMC as a
	  read-only target of the flash management page, next to boot0 and
	  boot1: it can be dumped and its blocks looked at in the hex
	  editor.

	  Reading is not authenticated, so the blocks come back exactly as
	  the device stores them (usually encrypted by whatever wrote them);
	  the response MAC is not verified because that needs the
	  authentication key.  Writing is deliberately not supported: it
	  would have to be authenticated with that key, which a bootloader
	  does not have.

	  This selects the RPMB support of the MMC layer
	  (CONFIG_SUPPORT_EMMC_RPMB), which brings in its SHA-256 HMAC
	  implementation (a few KiB of code) - that is the only cost of
	  this option.

config WEBUI_FAILSAFE_BL31
	bool "Report the BL31 version banner"
	depends on ARM
	default y
	help
	  Report the version and build date of the BL31 (ATF EL3 runtime)
	  currently stored in flash through the manual /atfversion
	  endpoint, next to the BL2 (preloader) banner.

	  BL31 is usually packed together with BL33 (U-Boot) inside one
	  FIP, so it is not always independently identifiable - and on
	  boards where the BL31 partition/volume does not exist, reading it
	  back just costs a storage read and reports "n/a".  Disabling this
	  drops the BL31 helper (failsafe/bootimg/bl31.c) from the image
	  and makes /atfversion report the BL2 banner only.

	  BL31 is stored compressed inside the FIP (LZMA on Airoha, XZ or
	  raw on MediaTek), so CONFIG_LZMA / CONFIG_XZ must be enabled as
	  well for the banner to be extractable; without the matching
	  decoder the BL31 fields stay "n/a".

endif # WEBUI_FAILSAFE_ADVANCED

endif # WEBUI_FAILSAFE
```
